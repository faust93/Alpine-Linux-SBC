/dts-v1/;
/plugin/;

/ {
	compatible = "rockchip,rk3308";

	fragment@0 {
		target = <&uart2>;
		__overlay__ {
			status = "disabled";
		};
	};

	fragment@1 {
		target = <&spi2>;
		__overlay__ {
			status = "disabled";
		};
	};

	fragment@2 {
		target = <&fiq_debugger>;
		__overlay__ {
			status = "okay";
			rockchip,serial-id = <2>;
			pinctrl-names = "default";
			pinctrl-0 = <&uart2m0_xfer>;
		};
	};
};

// Definitions for w1-gpio module (without external pullup)
/dts-v1/;
/plugin/;

/ {
	compatible = "rockchip,rk3308";

	fragment@0 {
		target-path = "/";
		__overlay__ {

			w1: onewire@0 {
				compatible = "w1-gpio";
				pinctrl-names = "default";
				gpios = <&gpio0 17 0 0xae>; // GPIO0_C1
				status = "okay";
			};
		};
	};
};

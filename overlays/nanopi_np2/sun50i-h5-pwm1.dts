/dts-v1/;
/plugin/;

/ {
	compatible = "allwinner,sun50i-h5";

	fragment@2 {
		target = <&pio>;
		__overlay__ {
			pwm0_pin: pwm0 {
				pins = "PA6";
				function = "i2s0";
			};
		};
	};

	fragment@3 {
		target = <&pwm>;
		__overlay__ {
			pinctrl-names = "default";
			pinctrl-0 = <&pwm0_pin>;
			status = "okay";
		};
	};
};
